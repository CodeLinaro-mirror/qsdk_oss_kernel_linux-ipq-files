## Documentation/devicetree/bindings/net/pcs/qcom,qce2204-pcs.yaml
```yaml
# SPDX-License-Identifier: (GPL-2.0-only OR BSD-2-Clause)
%YAML 1.2
---
$id: http://devicetree.org/schemas/net/pcs/qcom,qce2204-pcs.yaml#
$schema: http://devicetree.org/meta-schemas/core.yaml#

title: Qualcomm QCE2204 PCS

maintainers:
  - Lei Wei <quic_leiwei@quicinc.com>

description:
  QCE2204 have two PCS devices named as PCS0 and PCS1, which support the
  interface mode SGMII, 2500BASE-X, 10G-BASER and USXGMII mode to connect
  with MAC5 and MAC0. They are accessible over the Ethernet MDIO bus.

properties:
  compatible:
    const: qcom,qce2204-pcs

  reg:
    maxItems: 1

  clocks:
    items:
      - description: PCS system clock
      - description: PCS RX clock
      - description: PCS TX clock
      - description: XPCS XGMII RX clock
      - description: XPCS XGMII TX clock

  clock-names:
    items:
      - const: sys
      - const: rx
      - const: tx
      - const: xgmii_rx
      - const: xgmii_tx

  resets:
    items:
      - description: PCS system reset
      - description: PCS RX reset
      - description: PCS TX reset
      - description: XPCS XGMII RX reset
      - description: XPCS XGMII TX reset
      - description: XPCS reset

  reset-names:
    items:
      - const: sys
      - const: rx
      - const: tx
      - const: xgmii_rx
      - const: xgmii_tx
      - const: xpcs

  '#clock-cells':
    const: 1

  qcom,overspeed:
    type: boolean
    description: Enable 12.5G overspeed for XPCS

required:
  - compatible
  - reg
  - clocks
  - clock-names
  - resets
  - reset-names
  - '#clock-cells'

additionalProperties: false

examples:
  - |
    #include <dt-bindings/clock/qcom,qce2204-nsscc.h>
    #include <dt-bindings/reset/qcom,qce2204-nsscc.h>

    mdio {
        #address-cells = <1>;
        #size-cells = <0>;
        ethernet-phy@6 {
            compatible = "qcom,qce2204-pcs";
            reg = <6>;
            clocks = <&qce2204_nsscc QCE2204_NSSCC_SRDS1_SYS_CLK>,
                     <&qce2204_nsscc QCE2204_NSSCC_MAC1_SRDS1_CH0_RX_CLK>,
                     <&qce2204_nsscc QCE2204_NSSCC_MAC1_SRDS1_CH0_RX_CLK>,
                     <&qce2204_nsscc QCE2204_NSSCC_MAC0_1_SRDS1_CH0_XGMII_RX_CLK>,
                     <&qce2204_nsscc QCE2204_NSSCC_MAC0_1_SRDS1_CH0_XGMII_TX_CLK>;
            clock-names = "sys", "rx", "tx", "xgmii_rx", "xgmii_tx";
            resets = <&qce2204_nsscc QCE2204_NSSCC_SRDS1_SYS_ARES>,
                     <&qce2204_nsscc QCE2204_NSSCC_MAC1_SRDS1_CH0_RX_ARES>,
                     <&qce2204_nsscc QCE2204_NSSCC_MAC1_SRDS1_CH0_TX_ARES>,
                     <&qce2204_nsscc QCE2204_NSSCC_MAC0_1_SRDS1_CH0_XGMII_RX_ARES>,
                     <&qce2204_nsscc QCE2204_NSSCC_MAC0_1_SRDS1_CH0_XGMII_TX_ARES>,
                     <&qce2204_nsscc QCE2204_NSSCC_SRDS1_XPCS_ARES>;
            reset-names = "sys", "rx", "tx", "xgmii_rx", "xgmii_tx", "xpcs";
            #clock-cells = <0x1>;
        };
    };
```

## Documentation/devicetree/bindings/soc/qcom/qcom,ipq9650-apss-comp.yaml
```yaml
# SPDX-License-Identifier: (GPL-2.0+ OR BSD-3-Clause)
# IPQ9650 NoC device tree source
#
# Copyright (c) Qualcomm Technologies, Inc. and/or its subsidiaries.

%YAML 1.2
---

title: Qualcomm IPQ9650 APSS Component Driver

description:
  The APSS (Application Processor Subsystem) component driver provides
  performance monitoring and profiling capabilities for the IPQ9650 SoC's
  application processor subsystem using histogram probes, trace probes,
  and event counters.

properties:
  compatible:
    enum:
      - qcom,apss-comp-driver
      - qcom,llcc-be-apss-comp-driver

  reg:
    minItems: 3
    maxItems: 9

  reg-names:
    minItems: 3
    maxItems: 9
    items:
      enum:
        - histprobe-base
        - histctrl-base
        - traceprobe-base
        - eventcounter-base
        - apss-cti-base
        - core-cti-base
        - gemnoc-chm-ec-base
        - gemnoc-pcnoc-ec-base
        - gemnoc-anoc-ec-base

  hist_bin_width:
    $ref: /schemas/types.yaml#/definitions/uint32
    description: Histogram bin width configuration

  ddr_addr_min_low:
    $ref: /schemas/types.yaml#/definitions/uint32
    description: Lower 32 bits of minimum DDR address

  ddr_addr_min_high:
    $ref: /schemas/types.yaml#/definitions/uint32
    description: Upper 32 bits of minimum DDR address

  ddr_addr_max_low:
    $ref: /schemas/types.yaml#/definitions/uint32
    description: Lower 32 bits of maximum DDR address

  ddr_addr_max_high:
    $ref: /schemas/types.yaml#/definitions/uint32
    description: Upper 32 bits of maximum DDR address

  trace_probe_extid_base:
    $ref: /schemas/types.yaml#/definitions/uint32
    description: Trace probe external ID base value

  trace_probe_extid_mask:
    $ref: /schemas/types.yaml#/definitions/uint32
    description: Trace probe external ID mask

  ec_ctl1_base_val:
    $ref: /schemas/types.yaml#/definitions/uint32
    description: Event counter control 1 base value

  apss_cti_num:
    $ref: /schemas/types.yaml#/definitions/uint32
    description: APSS CTI (Cross Trigger Interface) number

  apss_cti_trigout_start:
    $ref: /schemas/types.yaml#/definitions/uint32
    description: APSS CTI trigger out start index

  apss_chi_read_event_id:
    $ref: /schemas/types.yaml#/definitions/uint32
    description: APSS CHI read event ID

  apss_chi_write_event_id:
    $ref: /schemas/types.yaml#/definitions/uint32
    description: APSS CHI write event ID

  apss_chi_cmo_event_id:
    $ref: /schemas/types.yaml#/definitions/uint32
    description: APSS CHI CMO (Cache Maintenance Operation) event ID

  apss_chi_all_event_id:
    $ref: /schemas/types.yaml#/definitions/uint32
    description: APSS CHI all events ID

  gemnoc_chm_ec_freq:
    $ref: /schemas/types.yaml#/definitions/uint32
    description: GEMNOC CHM event counter frequency in MHz

  gemnoc_pcnoc_ec_freq:
    $ref: /schemas/types.yaml#/definitions/uint32
    description: GEMNOC PCNOC event counter frequency in MHz

  gemnoc_anoc_ec_freq:
    $ref: /schemas/types.yaml#/definitions/uint32
    description: GEMNOC ANOC event counter frequency in MHz

  status:
    description: Device status
    enum:
      - okay
      - disabled

required:
  - compatible
  - reg
  - reg-names

additionalProperties: false

examples:
  - |
    soc {
        #address-cells = <1>;
        #size-cells = <1>;

        apss-comp-driver@4304400 {
            compatible = "qcom,apss-comp-driver";
            reg = <0x4304800 0x400>,
                  <0x4304400 0x400>,
                  <0x4305800 0x1000>,
                  <0x431A000 0x1000>,
                  <0x680E000 0x1500>,
                  <0x6010000 0x1500>,
                  <0x431A000 0x1000>,
                  <0x431B000 0x1000>,
                  <0x431C000 0x1000>;
            reg-names = "histprobe-base", "histctrl-base", "traceprobe-base",
                        "eventcounter-base", "apss-cti-base", "core-cti-base",
                        "gemnoc-chm-ec-base", "gemnoc-pcnoc-ec-base",
                        "gemnoc-anoc-ec-base";
            hist_bin_width = <0x2018>;
            ddr_addr_min_low = <0x80000000>;
            ddr_addr_min_high = <0x0>;
            ddr_addr_max_low = <0xffffffff>;
            ddr_addr_max_high = <0xfff>;
            trace_probe_extid_base = <0x4000>;
            trace_probe_extid_mask = <0xff00>;
            ec_ctl1_base_val = <180>;
            apss_cti_num = <9>;
            apss_cti_trigout_start = <2>;
            apss_chi_read_event_id = <180>;
            apss_chi_write_event_id = <182>;
            apss_chi_cmo_event_id = <184>;
            apss_chi_all_event_id = <186>;
            gemnoc_chm_ec_freq = <800>;
            gemnoc_pcnoc_ec_freq = <266>;
            gemnoc_anoc_ec_freq = <342>;
            status = "okay";
        };
    };
```

## Documentation/devicetree/bindings/soc/qcom/qcom,ipq9650-noc-tprobe.yaml
```yaml
# SPDX-License-Identifier: (GPL-2.0+ OR BSD-3-Clause)
# IPQ9650 NoC device tree source
#
# Copyright (c) Qualcomm Technologies, Inc. and/or its subsidiaries.
%YAML 1.2
---
title: Qualcomm IPQ9650 NoC Trace Probe Driver

description:
  The NoC (Network-on-Chip) trace probe driver provides monitoring and
  profiling capabilities for the IPQ9650 SoC's interconnect fabric.

properties:
  compatible:
    const: qcom,noc-tprobe-driver

  status:
    description: Device status
    enum:
      - okay
      - disabled

required:
  - compatible

additionalProperties: false

examples:
  - |
    soc {
        #address-cells = <1>;
        #size-cells = <1>;

        noc-tprobe-driver {
            compatible = "qcom,noc-tprobe-driver";
            status = "okay";
        };
    };
```

## Documentation/devicetree/bindings/soc/qcom/qcom,ipq9650-pcie-comp.yaml
```yaml
# SPDX-License-Identifier: (GPL-2.0+ OR BSD-3-Clause)
# IPQ9650 NoC device tree source
#
# Copyright (c) Qualcomm Technologies, Inc. and/or its subsidiaries.
%YAML 1.2
---
title: Qualcomm IPQ9650 PCIe Component Driver

description:
  The PCIe component driver provides performance monitoring and profiling
  capabilities for the IPQ9650 SoC's PCIe lanes using histogram probes,
  histogram controllers, trace probes, and event counters.

properties:
  compatible:
    enum:
      - qcom,pcie-1lane-0-comp-driver-juhu
      - qcom,pcie-2lane-0-comp-driver-juhu
      - qcom,pcie-2lane-1-comp-driver-juhu
      - qcom,pcie-2lane-2-comp-driver-juhu

  reg:
    items:
      - description: HistProbe base address
      - description: HistCtrl base address
      - description: TraceProbe base address
      - description: EventCounter base address
      - description: Core CTI base address

  reg-names:
    items:
      - const: histprobe-base
      - const: histctrl-base
      - const: traceprobe-base
      - const: eventcounter-base
      - const: core-cti-base

  hist_bin_width:
    $ref: /schemas/types.yaml#/definitions/uint32
    description: Histogram bin width configuration

  ddr_addr_min_low:
    $ref: /schemas/types.yaml#/definitions/uint32
    description: Lower 32 bits of minimum DDR address

  ddr_addr_min_high:
    $ref: /schemas/types.yaml#/definitions/uint32
    description: Upper 32 bits of minimum DDR address

  ddr_addr_max_low:
    $ref: /schemas/types.yaml#/definitions/uint32
    description: Lower 32 bits of maximum DDR address

  ddr_addr_max_high:
    $ref: /schemas/types.yaml#/definitions/uint32
    description: Upper 32 bits of maximum DDR address

  trace_probe_extid_base:
    $ref: /schemas/types.yaml#/definitions/uint32
    description: Trace probe external ID base value

  trace_probe_extid_mask:
    $ref: /schemas/types.yaml#/definitions/uint32
    description: Trace probe external ID mask

  ec_ctl1_base_val:
    $ref: /schemas/types.yaml#/definitions/uint32
    description: Event counter control 1 base value

  core_cti_num:
    $ref: /schemas/types.yaml#/definitions/uint32
    description: Core CTI (Cross Trigger Interface) number

  core_cti_trigout_start:
    $ref: /schemas/types.yaml#/definitions/uint32
    description: Core CTI trigger out start index

  ec_cti_num:
    $ref: /schemas/types.yaml#/definitions/uint32
    description: Event counter CTI number

  ec_cti_trigout:
    $ref: /schemas/types.yaml#/definitions/uint32
    description: Event counter CTI trigger out index

  status:
    description: Device status
    enum:
      - okay
      - disabled

required:
  - compatible
  - reg
  - reg-names

additionalProperties: false

examples:
  - |
    soc {
        #address-cells = <1>;
        #size-cells = <1>;

        pcie-1lane-0-comp-driver@601400 {
            compatible = "qcom,pcie-1lane-0-comp-driver-juhu";
            reg = <0x602800 0x400>,
                  <0x601400 0x400>,
                  <0x604000 0x1000>,
                  <0x605000 0x1000>,
                  <0x6010000 0x1500>;
            reg-names = "histprobe-base", "histctrl-base", "traceprobe-base",
                        "eventcounter-base", "core-cti-base";
            hist_bin_width = <0x2018>;
            ddr_addr_min_low = <0x0>;
            ddr_addr_min_high = <0x0>;
            ddr_addr_max_low = <0xffffffff>;
            ddr_addr_max_high = <0xff>;
            trace_probe_extid_base = <0x4500>;
            trace_probe_extid_mask = <0xff00>;
            ec_ctl1_base_val = <4>;
            core_cti_num = <11>;
            core_cti_trigout_start = <6>;
            ec_cti_num = <13>;
            ec_cti_trigout = <1>;
            status = "disabled";
        };

        pcie-2lane-0-comp-driver@601C00 {
            compatible = "qcom,pcie-2lane-0-comp-driver-juhu";
            reg = <0x602C00 0x400>,
                  <0x601C00 0x400>,
                  <0x604000 0x1000>,
                  <0x605000 0x1000>,
                  <0x6010000 0x1500>;
            reg-names = "histprobe-base", "histctrl-base", "traceprobe-base",
                        "eventcounter-base", "core-cti-base";
            hist_bin_width = <0x2018>;
            ddr_addr_min_low = <0x0>;
            ddr_addr_min_high = <0x0>;
            ddr_addr_max_low = <0xffffffff>;
            ddr_addr_max_high = <0xff>;
            trace_probe_extid_base = <0x4600>;
            trace_probe_extid_mask = <0xff00>;
            ec_ctl1_base_val = <4>;
            core_cti_num = <15>;
            core_cti_trigout_start = <4>;
            ec_cti_num = <13>;
            ec_cti_trigout = <1>;
            status = "okay";
        };
    };
```
