## Documentation/devicetree/bindings/soc/qcom/qcom,ipq9650-ppe-comp.yaml
```yaml
# SPDX-License-Identifier: (GPL-2.0+ OR BSD-3-Clause)
# IPQ9650 NoC device tree source
#
# Copyright (c) Qualcomm Technologies, Inc. and/or its subsidiaries.
%YAML 1.2
---
title: Qualcomm IPQ9650 PPE Component Driver

description:
  The PPE (Packet Processing Engine) component driver provides performance
  monitoring and profiling capabilities for the IPQ9650 SoC's NSS/PPE
  subsystem using tenure probes, trace probes, and event counters.

properties:
  compatible:
    const: qcom,ppe-comp-driver

  reg:
    items:
      - description: TenureProbe base address
      - description: TraceProbe base address
      - description: EventCounter base address
      - description: Core CTI base address

  reg-names:
    items:
      - const: tenureprobe-base
      - const: traceprobe-base
      - const: eventcounter-base
      - const: core-cti-base

  hist_bin_width:
    $ref: /schemas/types.yaml#/definitions/uint32
    description: Histogram bin width configuration

  ddr_addr_min_low:
    $ref: /schemas/types.yaml#/definitions/uint32
    description: Lower 32 bits of minimum DDR address

  ddr_addr_min_high:
    $ref: /schemas/types.yaml#/definitions/uint32
    description: Upper 32 bits of minimum DDR address

  ddr_addr_max_low:
    $ref: /schemas/types.yaml#/definitions/uint32
    description: Lower 32 bits of maximum DDR address

  ddr_addr_max_high:
    $ref: /schemas/types.yaml#/definitions/uint32
    description: Upper 32 bits of maximum DDR address

  trace_probe_extid_base:
    $ref: /schemas/types.yaml#/definitions/uint32
    description: Trace probe external ID base value

  trace_probe_extid_mask:
    $ref: /schemas/types.yaml#/definitions/uint32
    description: Trace probe external ID mask

  ec_ctl1_base_val:
    $ref: /schemas/types.yaml#/definitions/uint32
    description: Event counter control 1 base value

  core_cti_num:
    $ref: /schemas/types.yaml#/definitions/uint32
    description: Core CTI (Cross Trigger Interface) number

  core_cti_trigout:
    $ref: /schemas/types.yaml#/definitions/uint32
    description: Core CTI trigger out index

  ppe_read_event_id:
    $ref: /schemas/types.yaml#/definitions/uint32
    description: PPE read event ID

  ppe_write_event_id:
    $ref: /schemas/types.yaml#/definitions/uint32
    description: PPE write event ID

  status:
    description: Device status
    enum:
      - okay
      - disabled

required:
  - compatible
  - reg
  - reg-names

additionalProperties: false

examples:
  - |
    soc {
        #address-cells = <1>;
        #size-cells = <1>;

        ppe-comp-driver@1d09000 {
            compatible = "qcom,ppe-comp-driver";
            reg = <0x1d09000 0x1000>,
                  <0x4320000 0x1000>,
                  <0x431A000 0x1000>,
                  <0x6010000 0x1000>;
            reg-names = "tenureprobe-base", "traceprobe-base",
                        "eventcounter-base", "core-cti-base";
            hist_bin_width = <0x101e>;
            ddr_addr_min_low = <0x80000000>;
            ddr_addr_min_high = <0x0>;
            ddr_addr_max_low = <0xffffffff>;
            ddr_addr_max_high = <0xf>;
            trace_probe_extid_base = <0x6300>;
            trace_probe_extid_mask = <0xff00>;
            ec_ctl1_base_val = <190>;
            core_cti_num = <5>;
            core_cti_trigout = <0>;
            ppe_read_event_id = <190>;
            ppe_write_event_id = <192>;
            status = "okay";
        };
    };
```

## Documentation/devicetree/bindings/soc/qcom/qcom,ipq9650-qci-snoop.yaml
```yaml
# SPDX-License-Identifier: (GPL-2.0+ OR BSD-3-Clause)
# IPQ9650 NoC device tree source
#
# Copyright (c) Qualcomm Technologies, Inc. and/or its subsidiaries.
%YAML 1.2
---
title: Qualcomm IPQ9650 QCI Snoop Component Driver

description:
  The QCI (Qualcomm Coherent Interconnect) snoop component driver provides
  monitoring capabilities for cache coherency operations in the IPQ9650 SoC.

properties:
  compatible:
    const: qcom,qci-snoop-comp-driver

  reg:
    maxItems: 1
    description: EventCounter base address

  reg-names:
    items:
      - const: eventcounter-base

  qcom,snoop-base:
    $ref: /schemas/types.yaml#/definitions/uint32
    description: Snoop base configuration value

  status:
    description: Device status
    enum:
      - okay
      - disabled

required:
  - compatible
  - reg
  - reg-names

additionalProperties: false

examples:
  - |
    soc {
        #address-cells = <1>;
        #size-cells = <1>;

        qci-snoop-comp {
            compatible = "qcom,qci-snoop-comp-driver";
            reg = <0x431A000 0x1000>;
            reg-names = "eventcounter-base";
            qcom,snoop-base = <0x24>;
            status = "okay";
        };
    };
```

## drivers/soc/qcom/tmelcom/qmi/Kconfig
```kconfig
# SPDX-License-Identifier: GPL-2.0-only

config QCOM_TMELCOM_QMI
	tristate "Qualcomm TMEL Communication QMI Client Infrastructure"
	depends on QRTR && QCOM_QMI_HELPERS
	help
	  Generic QMI-based communication infrastructure for TME-L (Trusted
	  Management Environment - Lite) services over PCIe. Provides QMI
	  client framework for Trestles devices attached via PCIe.

	  Currently supports TME service (0x5F) for attestation, provisioning,
	  and licensing operations. The infrastructure is designed to be
	  extensible for additional TME-L services in the future.

	  The driver provides sysfs interface for monitoring and debugging,
	  and exposes kernel APIs for other drivers to communicate with
	  TME-L services.

	  Say Y or M here to enable TME-L QMI client support.
```
