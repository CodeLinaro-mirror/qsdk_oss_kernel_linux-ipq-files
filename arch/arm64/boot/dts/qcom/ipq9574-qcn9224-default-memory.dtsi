// SPDX-License-Identifier: (GPL-2.0+ OR BSD-3-Clause)
/*
 * IPQ9574 Memory device tree source
 *
 * Copyright (c) 2021 The Linux Foundation. All rights reserved.
 * Copyright (c) 2021-2023 Qualcomm Innovation Center, Inc. All rights reserved.
 */

#ifdef __IPQ_MEM_PROFILE_512_MB__
#include "ipq9574-qcn9224-512MB-memory.dtsi"
#else
/ {

	/*		Default Profile for Waikiki
	* +=========+==============+========================+
	* |        |              |                         |
	* | Region | Start Offset |          Size           |
	* |        |              |                         |
	* +--------+--------------+-------------------------+
	* |        |              |                         |
	* |        |              |                         |
	* | WLAN   |              |                         |
	* |   Q6   |  0x4AB00000  |          43MB           |
	* |        |              |                         |
	* |        |              |                         |
	* +--------+--------------+-------------------------+
	* | M3 Dump|  0x4D600000  |           1MB           |
	* +--------+--------------+-------------------------+
	* | WLAN   |              |                         |
	* | Q6 ETR |  0x4D700000  |           1MB           |
	* | Region |              |                         |
	* +--------+--------------+-------------------------+
	* | caldb  |  0x4D800000  |           5MB           |
	* +--------+--------------+-------------------------+
	* |        |              |                         |
	* |QCN9224 |  0x4DD00000  |          36MB           |
	* |PCIE0   |              |                         |
	* |        |              |                         |
	* +--------+--------------+-------------------------+
	* |        |              |                         |
	* |QCN9224 |  0x50100000  |          36MB           |
	* |PCIE1   |              |                         |
	* |        |              |                         |
	* +--------+--------------+-------------------------+
	* |        |              |                         |
	* |QCN9224 |  0x52500000  |          36MB           |
	* |PCIE2   |              |                         |
	* |        |              |                         |
	* +--------+--------------+-------------------------+
	* |        |              |                         |
	* |QCN9224 |  0x54900000  |          36MB           |
	* |PCIE3   |              |                         |
	* |        |              |                         |
	* +--------+--------------+-------------------------+
	* | QCN9000|              |                         |
	* |  SCAN  |  0x56D00000  |          53MB           |
	* |  RADIO |              |                         |
	* +--------+--------------+-------------------------+
	* |        |              |                         |
	* |  MHI0  |    DYNAMIC   |          9MB           |
	* |        |              |                         |
	* +--------+--------------+-------------------------+
	* |        |              |                         |
	* |  MHI1  |    DYNAMIC   |          9MB           |
	* |        |              |                         |
	* +--------+--------------+-------------------------+
	* |        |              |                         |
	* |  MHI2  |    DYNAMIC   |          9MB           |
	* |        |              |                         |
	* +--------+--------------+-------------------------+
	* |        |              |                         |
	* |  MHI3  |    DYNAMIC   |          9MB           |
	* |        |              |                         |
	* +--------+--------------+-------------------------+
	* |        |              |                         |
	* |  MLO   |    DYNAMIC   |          18MB           |
	* |        |              |                         |
	* +=================================================+
	* |                                                 |
	* |                                                 |
	* |                                                 |
	* |            Rest of memory for Linux             |
	* |                                                 |
	* |                                                 |
	* |                                                 |
	* +=================================================+
	*/

	reserved-memory {
		#address-cells = <2>;
		#size-cells = <2>;
		ranges;

		q6_region: wcnss@4ab00000 {
			no-map;
			reg = <0x0 0x4ab00000 0x0 0x02b00000>;
			status = "disabled";
		};

		m3_dump: m3_dump@4d600000 {
			no-map;
			reg = <0x0 0x4D600000 0x0 0x100000>;
			status = "disabled";
		};

		q6_etr_region: q6_etr_dump@1 {
			no-map;
			reg = <0x0 0x4D700000 0x0 0x100000>;
			status = "disabled";
		};

		q6_caldb_region:q6_caldb_region@4d800000 {
			no-map;
			reg = <0x0 0x4D800000 0x0 0x500000>;
			status = "disabled";
		};

		qcn9224_pcie0: qcn9224_pcie0@4dd00000 {
			no-map;
			reg = <0x0 0x4DD00000 0x0 0x02400000>;
			status = "disabled";
		};

		qcn9224_pcie1: qcn9224_pcie1@50100000 {
			no-map;
			reg = <0x0 0x50100000 0x0 0x02400000>;
			status = "disabled";
		};

		qcn9224_pcie2: qcn9224_pcie2@52500000 {
			no-map;
			reg = <0x0 0x52500000 0x0 0x02400000>;
			status = "disabled";
		};

		qcn9224_pcie3: qcn9224_pcie3@54900000 {
			no-map;
			reg = <0x0 0x54900000 0x0 0x02400000>;
			status = "disabled";
                };

		qcn9000_pcie0: qcn9000_pcie0@56d00000 {
			no-map;
			reg = <0x0 0x56D00000 0x0 0x03A00000>;
			status = "disabled";
                };

		tzapp: tzapp@0 {  /* TZAPPS */
			no-map;
		};

		mhi_region0: dma_pool0@0 {
			compatible = "shared-dma-pool";
			no-map;
			size = <0x0 0x00900000>;
			alignment = <0x0 0x1000>;
			status = "disabled";
		};

		mhi_region1: dma_pool1@1 {
			compatible = "shared-dma-pool";
			no-map;
			size = <0x0 0x00900000>;
			alignment = <0x0 0x1000>;
			status = "disabled";
                };

		mhi_region2: dma_pool2@2 {
			compatible = "shared-dma-pool";
			no-map;
			size = <0x0 0x00900000>;
			alignment = <0x0 0x1000>;
			status = "disabled";
		};

		mhi_region3: dma_pool3@3 {
			compatible = "shared-dma-pool";
			no-map;
			size = <0x0 0x00900000>;
			alignment = <0x0 0x1000>;
			status = "disabled";
                };

		mlo_global_mem0: mlo_global_mem_0@0 {
			no-map;
			size = <0x0 0x1200000>;
			alignment = <0x0 0x100000>;
			status = "disabled";
		};

	};
};
#endif
