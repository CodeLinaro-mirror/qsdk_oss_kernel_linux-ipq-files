// SPDX-License-Identifier: (GPL-2.0+ OR BSD-3-Clause)
/*
 * DEVSOC RDP487 board device tree source
 *
 * Copyright (c) 2024 Qualcomm Innovation Center, Inc. All rights reserved.
 */

#include <arm64/qcom/devsoc-rdp487.dts>
