// SPDX-License-Identifier: (GPL-2.0+ OR BSD-3-Clause)
/*
 * IPQ5610 Emulation board device tree source
 *
 * Copyright (c) 2020 The Linux Foundation. All rights reserved.
 * Copyright (c) Qualcomm Technologies, Inc. and/or its subsidiaries.
 */

#include <arm64/qcom/ipq5610-emulation.dts>

/ {
	cpus {
		/delete-node/ cpu@300;
		/delete-node/ cpu-map;
	};

	/delete-node/ pmu-a78;

	pmu-dsu {
		compatible = "arm,dsu-pmu";
		interrupts = <GIC_SPI 50 IRQ_TYPE_EDGE_RISING>;
		cpus = <&cpu0>, <&cpu1>, <&cpu2>;
		status = "disabled";
	};

};
