// SPDX-License-Identifier: ISC
/*
 * IPQ5424 RDP464-C5 board device tree source
 *
 * Copyright (c) Qualcomm Technologies, Inc. and/or its subsidiaries.
 */

#include <arm64/qcom/ipq5424-rdp464-c5.dts>
